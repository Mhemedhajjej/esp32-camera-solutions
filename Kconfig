## Kconfig
```kconfig
menu "ESP32 Camera Solutions Configuration"

config ESP32_CAMERA_SOLUTIONS
    bool "Enable ESP32 Camera Solutions application"
    default y

endmenu
```

## components/camera_service/Kconfig
```kconfig
menu "Camera Service"

config CAMERA_SERVICE_XCLK_FREQ_HZ
	int "XCLK frequency (Hz)"
	range 1000000 40000000
	default 20000000
	help
		External clock frequency for the camera sensor.

config CAMERA_SERVICE_PIN_PWDN
	int "Pin PWDN"
	default 32
	help
		Power down GPIO. Set to -1 if not connected.

config CAMERA_SERVICE_PIN_RESET
	int "Pin RESET"
	default -1
	help
		Reset GPIO. Set to -1 if not connected.

config CAMERA_SERVICE_PIN_XCLK
	int "Pin XCLK"
	default 0

config CAMERA_SERVICE_PIN_SIOD
	int "Pin SIOD"
	default 26

config CAMERA_SERVICE_PIN_SIOC
	int "Pin SIOC"
	default 27

config CAMERA_SERVICE_PIN_D7
	int "Pin D7"
	default 35

config CAMERA_SERVICE_PIN_D6
	int "Pin D6"
	default 34

config CAMERA_SERVICE_PIN_D5
	int "Pin D5"
	default 39

config CAMERA_SERVICE_PIN_D4
	int "Pin D4"
	default 36

config CAMERA_SERVICE_PIN_D3
	int "Pin D3"
	default 21

config CAMERA_SERVICE_PIN_D2
	int "Pin D2"
	default 19

config CAMERA_SERVICE_PIN_D1
	int "Pin D1"
	default 18

config CAMERA_SERVICE_PIN_D0
	int "Pin D0"
	default 5

config CAMERA_SERVICE_PIN_VSYNC
	int "Pin VSYNC"
	default 25

config CAMERA_SERVICE_PIN_HREF
	int "Pin HREF"
	default 23

config CAMERA_SERVICE_PIN_PCLK
	int "Pin PCLK"
	default 22

config CAMERA_SERVICE_FRAME_SIZE
	int "Frame buffer size (bytes)"
	default 65536
	help
		Size in bytes of each allocated frame buffer.
		Increase for higher resolutions (e.g., 307200 for VGA).

config CAMERA_SERVICE_FRAME_BUF_COUNT
	int "Number of frame buffers"
	range 1 4
	default 1
	help
		Number of DMA frame buffers to allocate.
		More buffers reduce frame drop rate at the cost of RAM.

config CAMERA_SERVICE_JPEG_QUALITY
	int "JPEG compression quality (0-63, lower = better)"
	range 0 63
	default 12
	help
		JPEG quantization quality parameter passed to the image sensor.

endmenu
```

## components/power_service/Kconfig
```kconfig
menu "Power Service"

config POWER_SERVICE_WAKEUP_GPIO
	int "Wakeup GPIO"
	default 33
	help
		RTC GPIO used as external wakeup source before deep sleep.

choice POWER_SERVICE_WAKEUP_EDGE
	prompt "Wakeup level"
	default POWER_SERVICE_WAKEUP_EDGE_HIGH
	help
		Expected signal level on the configured wakeup GPIO.

config POWER_SERVICE_WAKEUP_EDGE_HIGH
	bool "HIGH"

config POWER_SERVICE_WAKEUP_EDGE_LOW
	bool "LOW"

endchoice

config POWER_SERVICE_WAKEUP_LEVEL
	bool
	default y if POWER_SERVICE_WAKEUP_EDGE_HIGH
	default n if POWER_SERVICE_WAKEUP_EDGE_LOW

config POWER_SERVICE_RTC_FALLBACK_TIMEOUT_S
	int "RTC fallback wakeup timeout (seconds)"
	range 0 86400
	default 3600
	help
		Fallback timer wakeup period in seconds. Set to 0 to disable.

endmenu
```

## components/service_manager/Kconfig
```kconfig
menu "Service Manager"

config SERVICE_MANAGER_IDLE_TIMEOUT_MS
	int "Idle timeout before sleep command (ms)"
	range 0 3600000
	default 30000
	help
		If no event is received for this duration, ServiceManager sends
		EnterSleep command to PowerService. Set to 0 to disable idle sleep.

endmenu
```

## components/wifi_service/Kconfig
```kconfig
menu "WiFi Service"

config WIFI_SERVICE_SSID
	string "WiFi SSID"
	default ""
	help
		SSID of the local WiFi network to join.

config WIFI_SERVICE_PASSWORD
	string "WiFi password"
	default ""
	help
		Password of the local WiFi network to join.

config WIFI_SERVICE_MAX_RETRY
	int "WiFi max reconnect retries"
	range 1 20
	default 8
	help
		Maximum reconnect attempts before a connect attempt is reported as failed.

config WIFI_SERVICE_CONNECT_TIMEOUT_MS
	int "WiFi connect timeout (ms)"
	range 1000 120000
	default 20000
	help
		How long to wait for STA connection and DHCP address.

config WIFI_SERVICE_UPLOAD_URL
	string "Receiver HTTP URL"
	default "http://192.168.1.10:8080/upload"
	help
		LAN receiver endpoint used to send JPEG captures.
		Typically this points to a local PC/Raspberry Pi/BeagleBone service
		that stores files on local disk.
		Examples:
		- http://raspberrypi.local:8080/upload
		- http://beaglebone.local:8080/upload
		- http://192.168.1.100:5000/upload

config WIFI_SERVICE_HTTP_TIMEOUT_MS
	int "HTTP timeout (ms)"
	range 1000 120000
	default 15000
	help
		Timeout used by the HTTP client while uploading a frame.

endmenu
```

## sdkconfig.defaults
```kconfig
# ESP32 Camera Solutions - Default configuration for v0.1

# Ensure app image has enough space for WiFi + HTTP upload features
# CONFIG_PARTITION_TABLE_SINGLE_APP is not set
CONFIG_PARTITION_TABLE_SINGLE_APP_LARGE=y
```
